#include "usart.h"





#define BUF_SIZE		(255)					// 缓冲区大小

#if UART1_SEND_ENB

static	INT8U			_txd_buff[BUF_SIZE];	// 发送缓冲区
static	INT8U           _txBusy;				// UART1发送器忙碌标志（1表示正在发送；0表示空闲）（该变量定义为位类型在FU6812上发现被意外修改，原因待查，先改为字节类型）
static	FIFO_TypeDef	fifoTxD;				  // 发送缓冲区 操作变量


/*****************************************************************************
* 功能:		设置UART1发送缓冲区
*****************************************************************************/
void UART1_SetFifoTxD(INT8U* adr, INT8U siz)
{
	fifoTxD.Addr = adr;						// 设置地址
	fifoTxD.Size = siz;						// 设置长度
	fifoTxD.Read = 0;							// 初始化读位置
	fifoTxD.Writ = 0;							// 初始化写位置
}




/*****************************************************************************
* 功能:		从发送缓冲区中取出数据逐个发送到UART端口
* 说明:		数据发送的流程为：
* 			1、先将数据存放到发送缓冲区。
* 			2、轮询程序或中断服务程序再从发送缓冲区中取出数据逐个发送到UART端口。
* 			该函数仅执行上面第2步。
* 说明：	UART1硬件模块封装了串行位的接收及发送，它提供了单个字节的读写。
* 			UART1中断程序封装了数据流的校验与搬运，它提供了数据块的读写。
* 			UART1中断程序引入了FIFO缓冲区的机制，有效缓解了快速的指令等待慢速的收发的矛盾。具体如下：
* 			中断发送服务程序负责将发送缓冲区中的数据逐字节发往UART端口。这样应用程序只需将待发送的数据存放到发送缓冲区即可立即返回。
* 			中断接收服务程序负责将从UART端口接收到的字节数据存入接收缓冲区。这样应用程序可以一次性的从接收缓冲区读取整个一帧的数据。
* 			若需要校验，中断发送服务程序会对每一个待发送的字节数据设置相应的奇/偶校验位后，再将数据发往UART端口。
* 			若需要校验，中断接收服务程序会对每一个接收到的字节数据做奇/偶校验，但即使校验出错，数据仍将存入接收缓冲区。
* 			中断接收服务程序只负责查错，若有错误，只将错误信息传递给上层应用程序。
* 			至于该怎么处理出错的数据，这是上层驱动要考虑的问题，中断接收服务程序不能越俎代庖。
* 			假如中断接收服务程序对出错的数据进行干预，比如自行过滤掉校验出错的数据，那将误导上层应用程序！
*****************************************************************************/
void UART1_SendScan(void)
{
	INT8U c;

	if (UART_TxdIsEmpty(UART1)) {				// 发送寄存器的数据已发送完（TI标志已被置1）
		if (FIFO_Out(&fifoTxD, &c)) {			// 从UART1发送缓冲区取出一个字节的待发送数据
			_txBusy = 1;						// 设置发送模块忙碌标志（防止新数据进入发送缓冲区时设置发送中断标志而引起冲突）
			UART_Send(UART1, c);				// 发送到UART1端口
		}
		else {									// 如果发送缓冲区中已经没有数据要发送，则发送中断服务程序进入空闲状态
			_txBusy = 0;						// 清除发送模块忙碌标志进入空闲状态（此后有新数据进入发送缓冲区时可重新触发发送中断）
		}
	}
}





/*****************************************************************************
* 功能:		发送一个字节数据到UART1
* 参数:		c:	待发送的字节数据
* 返回:		1：成功发送了一个字节数据；0：未发送数据（发送缓冲区已满，可稍等一会再尝试发送）
* 说明:		数据发送的流程为：
* 			1、先将数据存放到发送缓冲区。
* 			2、轮询程序或中断服务程序再从发送缓冲区中取出数据逐个发送到UART端口。
* 			该函数仅执行上面第1步。
* 			串口发送分两步的好处是，无需等待。
* 			如果发现发送缓冲区已满，则不等待缓冲区变空，也立即返回。（此时待发送的数据并未发送，如果需要，过一会再重新发送）
* 			这里之所以不等待，除了让调用方有机会利用等待的这段时间做点别的事情以外，更重要的是，为了允许更高优先级的中断服务程
* 			序也能调用该函数发送数据到UART1。假如更高优先级的中断服务程序调用该函数发送一个数据时发现缓冲区已满，这时若等待其
* 			变空，实际上永远也等不到其变空！因为你等他的同时，他也在等你，由此造成死锁。
* 			因此不能等待，不管发送成功与否，都立即返回。
*****************************************************************************/
INT8U UART1_SendByte(INT8U c)
{
	INT8U	i = 0;
	if (FIFO_In(&fifoTxD, c)) {					// 数据放入发送缓冲区
		if (!_txBusy) {							// 如果发送模块空闲，则通知中断服务程序有新的数据需要发送
		}										// 因为中断通常会立即得到服务，立即将新数据发往端口，而这时端口正忙呢，所以会导致发送冲突。
		i = 1;									// 成功放入一个字节数据
	}
	return i;									// 返回实际发送的字节数
}



/*****************************************************************************
* 功能:		发送一批数据到UART1
* 参数:		n:	待发送的字节数
* 			s:	待发送数据的存放首地址
* 返回:		实际发送完的字节数（0表示发送缓冲区已满，未成功发送的数据根据需要决定是否重新发送）
* 说明:		也可以调用该函数一次性发送一批数据到UART1，首地址处的数据会被最先发送。
*****************************************************************************/
INT8U UART1_SendBytes(INT16U n, INT8U* s)
{
	INT8U i = 0;
	while (n && FIFO_In(&fifoTxD, s[i])) {		// 数据逐个放入发送缓冲区
		n--;
		i++;									// 累加实际收取到的字节数
		if (!_txBusy) {							// 如果发送模块空闲，则通知中断服务程序有新的数据需要发送
		}										// 因为中断通常会立即得到服务，立即将新数据发往端口，而这时端口正忙呢，所以会导致发送冲突。
	}
	return i;									// 返回实际发送完的字节数
}







/*****************************************************************************
* 功能:		发送一个字符串到UART1
* 参数:		s:	待发送字符串的首地址
* 返回:		成功发送的字符数
*****************************************************************************/
INT8U UART1_SendString(INT8* s)
{
	INT8U	c, cnt = 0;
	for (c = *s; c; c = *++s) {
		if (UART1_SendByte(c))	cnt++;
		else					return cnt;
	}
	return cnt;									// 返回实际发送的字节数
}





/*****************************************************************************
* 功能:		将一个正整数转换为字符串并发送到UART1
* 参数:		v:	待输出整数值
* 			n:	n位对齐（不足n位，前补空格。超过n位按实际位数发送）
* 			c:	对齐的字符
* 返回:		实际输出到超级终端的字符数
*****************************************************************************/
INT8U UART1_SendValueU(INT32U v, INT8U n, INT8U c)
{
	INT8U	buf[10], i = 0, cnt = 0;
	if (v) {
		for (; v; v /= 10)	buf[i++] = (v % 10) + '0';// 从低位到高位，逐个提取出数字
	}
	else {
		buf[i++] = '0';
	}
	for (; n > i; n--)	UART1_SendByte(c);			// 补指定字符以便对齐
	while (i) {
		if (UART1_SendByte(buf[--i]))	cnt++;		// 统计实际输出的字符数
		else					return cnt;			// 返回实际输出的字符数
	}
	return cnt;										// 返回实际输出的字符数
}





/*****************************************************************************
* 功能:		将一个正整数转换为字符串并发送到UART1
* 参数:		v:	待输出整数值
* 			n:	n位对齐（不足n位，前补空格。超过n位按实际位数发送）
* 			c:	对齐的字符
* 返回:		实际输出到超级终端的字符数
*****************************************************************************/
INT8U UART1_SendValueS(INT32S v, INT8U n, INT8U c)
{
	INT8U	buf[11], i = 0, cnt = 0, s = 0;
	if (v < 0) {
		v = 0 - v;
		s = 1;
		n--;
	}
	if (v) {
		for (; v; v /= 10)	buf[i++] = (v % 10) + '0';// 从低位到高位，逐个提取出数字
	}
	else {
		buf[i++] = '0';
	}
	for (; n > i; n--)	UART1_SendByte(c);			// 补指定字符以便对齐
	if (s) {
		buf[i++] = '-';
	}
	while (i) {
		if (UART1_SendByte(buf[--i]))	cnt++;		// 统计实际输出的字符数
		else					return cnt;			// 返回实际输出的字符数
	}
	return cnt;										// 返回实际输出的字符数
}



#endif	






















#if UART1_RECV_ENB

static	INT8U			_rxd_buff[BUF_SIZE];	// 接收缓冲区
static	FIFO_TypeDef	fifoRxD;				// 接收缓冲区 操作变量



/*****************************************************************************
* 功能:		设置UART1接收缓冲区
*****************************************************************************/
void UART1_SetFifoRxD(INT8U* adr, INT8U siz)
{
	fifoRxD.Addr = adr;							// 设置地址
	fifoRxD.Size = siz;							// 设置长度
	fifoRxD.Read = 0;							// 初始化读位置
	fifoRxD.Writ = 0;							// 初始化写位置
}


/*****************************************************************************
* 功能:		将UART1端口收到的数据存放到接收缓冲区中
* 参数:		c:	接收到的数据
* 返回:		1：成功；0：失败（接收缓冲区已满，发生溢出）
* 说明:		数据接收的流程为：
* 			1、中断服务程序先将UART端口收到的数据存放到接收缓冲区。
* 			2、相关应用程序再从接收缓冲区中逐个读取数据并解码。
* 			该函数仅执行上面第1步。
* 			串口接收分两步的好处是，减轻中断服务程序的负荷。
* 说明：	UART1硬件模块封装了串行位的接收及发送，它提供了单个字节的读写。
* 			UART1中断程序封装了数据流的校验与搬运，它提供了数据块的读写。
* 			UART1中断程序引入了FIFO缓冲区的机制，有效缓解了快速的指令等待慢速的收发的矛盾。具体如下：
* 			中断发送服务程序负责将发送缓冲区中的数据逐字节发往UART端口。这样应用程序只需将待发送的数据存放到发送缓冲区即可立即返回。
* 			中断接收服务程序负责将从UART端口接收到的字节数据存入接收缓冲区。这样应用程序可以一次性的从接收缓冲区读取整个一帧的数据。
* 			若需要校验，中断发送服务程序会对每一个待发送的字节数据设置相应的奇/偶校验位后，再将数据发往UART端口。
* 			若需要校验，中断接收服务程序会对每一个接收到的字节数据做奇/偶校验，但即使校验出错，数据仍将存入接收缓冲区。
* 			中断接收服务程序只负责查错，若有错误，只将错误信息传递给上层应用程序。
* 			至于该怎么处理出错的数据，这是上层驱动要考虑的问题，中断接收服务程序不能越俎代庖。
* 			假如中断接收服务程序对出错的数据进行干预，比如自行过滤掉校验出错的数据，那将误导上层应用程序！
*****************************************************************************/
INT8U UART1_RecvByte(INT8U c)
{
	INT8U	i = 0;

	if (!FIFO_IsFull(&fifoRxD)) {				// 接收缓冲区未满，则
		i = FIFO_In(&fifoRxD, c);				// 存入数据
	}
	else {										// 接收缓冲区已满

	}
	return i;									// 返回实际接收的字节数
}


void UART1_RecvDecode(INT8U dat);
/*****************************************************************************
* 功能:		从接收缓冲区中逐个读取数据并解码。
* 说明:		数据接收的流程为：
* 			1、中断服务程序先将UART端口收到的数据存放到接收缓冲区。
* 			2、相关应用程序再从接收缓冲区中逐个读取数据并解码。
* 			该函数仅执行上面第2步。
* 			串口接收分两步的好处是，减轻中断服务程序的负荷。
*****************************************************************************/
void UART1_RecvScan(void)
{
	INT8U	i, dat;
	while (!FIFO_IsEmpty(&fifoRxD)) {				// 接收缓冲区非空，则
		i = FIFO_Out(&fifoRxD, &dat);				// 逐字节取出数据
		if (i) {									// 取出数据成功
			UART1_RecvDecode(dat);					// 解码
		}
	}
}


#endif



/*****************************************************************************
* 功能:		UART1初始化
* 参数:		baud:	波特率（单位：bps）
*****************************************************************************/
void UART1_Init(INT32U baud)
{

#if (UART1_SEND_ENB)
	_txBusy = 0;								// 置发送模块为空闲
	UART1_SetFifoTxD(_txd_buff, BUF_SIZE);
	UART_DisableTxdInt(UART1);
#endif	

#if (UART1_RECV_ENB)

	UART1_SetFifoRxD(_rxd_buff, BUF_SIZE);
	UART_GetIntFlag(UART1);
	UART_EnableRxdInt(UART1);
#endif	

	UART_ConfigRunMode(UART1, baud, UART_WLS_8, UART_PARITY_NONE, UART_STOP_BIT_1);
	NVIC_EnableIRQ(UART1_IRQn);
	NVIC_SetPriority(UART1_IRQn, 0);
	SYS_EnablePeripheralClk(SYS_CLK_UART1_MSK);
}






/***********************************************************************************************************************************/
/*                                                     循环队列                                                                    */
/***********************************************************************************************************************************/
/*****************************************************************************
* 功能:		获取FIFO缓冲区中数据的个数
* 返回:		数量
*****************************************************************************/
INT8U FIFO_GetCnt(FIFO_TypeDef* fifo)
{
	return (fifo->Writ - fifo->Read);
}

/*****************************************************************************
* 功能:		检查FIFO缓冲区是否为空
* 返回:		1表示空，0表示非空。
*****************************************************************************/
INT8U FIFO_IsEmpty(FIFO_TypeDef* fifo)
{
	if (fifo->Writ == fifo->Read)	return 1;
	else							return 0;
}

/*****************************************************************************
* 功能:		检查FIFO缓冲区是否已满
* 返回:		1表示已满，0表示未满。
*****************************************************************************/
INT8U FIFO_IsFull(FIFO_TypeDef* fifo)
{
	if ((fifo->Writ + 1) % fifo->Size == fifo->Read)	return 1;
	else										return 0;
}

/*****************************************************************************
* 功能:		写入一个数据到FIFO缓冲区
* 返回:		1表示成功，0表示失败（缓冲区已满）。
*****************************************************************************/
INT8U FIFO_In(FIFO_TypeDef* fifo, INT8U dat)
{
	if (FIFO_IsFull(fifo))	return 0;			// FIFO已满，失败返回
	fifo->Addr[fifo->Writ] = dat;				// 数据写入FIFO
	fifo->Writ += 1;							// 调整写入位置
	fifo->Writ %= fifo->Size;					// 位置卷绕
	return 1;									// 成功返回
}

/*****************************************************************************
* 功能:		从FIFO缓冲区读出一个数据
* 返回:		1表示成功，0表示失败（缓冲区已空）。
*****************************************************************************/
INT8U FIFO_Out(FIFO_TypeDef* fifo, INT8U* dat)
{
	if (FIFO_IsEmpty(fifo))	return 0;			// FIFO已空，失败返回
	*dat = fifo->Addr[fifo->Read];				// 数据读出
	fifo->Read += 1;							// 调整读出位置
	fifo->Read %= fifo->Size;					// 位置卷绕
	return 1;									// 成功返回
}
