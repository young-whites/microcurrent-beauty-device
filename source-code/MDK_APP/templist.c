#include "templist.h"




volatile uint16_t TEMP_adc[131] = {

3345,// -5
3310,// -4
3275,// -3
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129	,//	125




};


uint16_t ADC_ConverStable(unsigned char channel)
{
    uint8_t i;
    uint16_t adcval;
    uint16_t minval = 0xFFFF;
    uint16_t maxval = 0;
    uint16_t averageval;
    uint32_t totalval = 0;

    for (i = 0; i < 18; i++)
    {
        if (!ADC1_IS_BUSY())
        {
            ADC1_Go();
            while (ADC1_IS_BUSY());
            if (channel == 1)
            {
                adcval = ADC1_GetResult(ADC1_CH_10);
            }
            
            if (channel == 2)
            {
                adcval = ADC1_GetResult(ADC1_CH_9);
            }
        }

        totalval += adcval;

        if (minval > adcval)
        {
            minval = adcval;
        }

        if (maxval < adcval)
        {
            maxval = adcval;
        }
    }

    totalval = totalval - minval - maxval;
    averageval = totalval / 16;
    return averageval;
}



int temp_ConverStable(void)
{
    uint8_t i;
    uint16_t Temperad;
    float temp0 = 0, temp1 = 0, temp2 = 0;

    Temperad = ADC_ConverStable(2);

    for (i = 0; i < 131; i++)          // ← 修改长度为131
    {
        if (Temperad > TEMP_adc[i])
        {
            temp0 = i - 5;             // ← 关键修改：从 -5℃ 开始
            break;
        }
    }

    if (i == 0)
    {
        temp0 = -5;                    // ← 最低温度钳位
    }
    else if (i >= 131)
    {
        temp0 = 125;                   // 最高温度
    }
    else
    {
        temp1 = TEMP_adc[i - 1] - TEMP_adc[i];
        temp2 = TEMP_adc[i - 1] - Temperad;
        temp0 = temp0 + temp2 / temp1;
    }
    return (int)temp0;                 // 返回整数温度
}


