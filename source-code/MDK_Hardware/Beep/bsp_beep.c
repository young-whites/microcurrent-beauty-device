#include "bsp_beep.h"


/*****************************************************************************
* 功能:		蜂鸣器端口初始化
*****************************************************************************/
void BEEP_GPIO_Config(void)
{
	// P05管脚配置 (BEP_EN)
	SYS_SET_IOCFG(IOP05CFG,SYS_IOCFG_P05_GPIO);							// 设置为GPIO模式
	GPIO_CONFIG_IO_MODE(BEEP_GPIO,BEEP_PIN,GPIO_MODE_OUTPUT_PUSH_PULL);	// 设置为推挽输出模式
	GPIO_ResetPin(BEEP_GPIO,BEEP_PIN_MSK);								// 初始化输出为低电平
}




/***********************************************************************************************************************/
/*                                                         蜂鸣器驱动                                                   */
/***********************************************************************************************************************/


static	INT16U	beepClk=0;						// 蜂鸣器鸣叫时钟（单位：ms）
static	INT16U	beepCyc=0;						// 蜂鸣器单次鸣叫的周期（一次完整鸣叫+间隔的总时间，单位：ms）
static	INT16U	beepDty=0;						// 蜂鸣器单次鸣叫的时间（周期中鸣叫所占的时间，单位：ms）
static	INT8U	beepCnt=0;							// 蜂鸣器鸣叫计数
static	INT8U	beepCry=0;							// 蜂鸣器鸣叫次数（0表示不鸣叫）
static	INT8U	beepMut=0;							// 蜂鸣器停顿周期数（0表示不停顿）
static	INT8U	beepCct=0;							// 蜂鸣器重复计数
static	INT8U	beepRep=0;							// 蜂鸣器重复鸣叫次数（0表示不重复，100以上表示无限重复）
//----------------------------------------------------------------------------

/*****************************************************************************
* 功能:		蜂鸣器关闭
*****************************************************************************/
void BEEP_Off(void)
{
	beepCry=0;										// 禁止（间隔）鸣叫
	BEEP_OutOff();
}

/*****************************************************************************
* 功能:		蜂鸣器长鸣
*****************************************************************************/
void BEEP_On(void)
{
	beepCry=0;										// 禁止（间隔）鸣叫
	BEEP_OutOn();
}

/*****************************************************************************
* 功能:		设置蜂鸣器鸣叫周期及占空比
* 参数:		Cycle	周期（一次完整鸣叫+间隔的总时间，单位：ms）
* 			Duty	占空比（周期中鸣叫所占的时间，单位：ms）
*****************************************************************************/
void BEEP_SetCycleDuty(INT16U Cycle, INT16U Duty)
{
	beepCyc=Cycle;
	beepDty=Duty;
	beepClk=0;
}

/*****************************************************************************
* 功能:		蜂鸣器鸣叫（指定次数）
* 参数:		cry		蜂鸣器鸣叫次数（0表示不鸣叫）
* 			mute	蜂鸣器停顿周期数（0表示不停顿）
* 			repeat	蜂鸣器重复鸣叫次数（0表示不重复，100以上表示无限重复）
*****************************************************************************/
void BEEP_Blink(INT8U cry, INT8U mute, INT8U repeat)
{
	beepCry=cry;
	beepMut=mute;
	beepRep=repeat;
	beepCnt=0;
	beepCct=0;
}

/*****************************************************************************
* 功能:		蜂鸣器扫描
* 说明:		扫描周期：1ms。
*****************************************************************************/
void BEEP_DrvScan(void)
{
	if(beepCry){									// 需要鸣叫
		if(++beepClk >= beepCyc){ 					// 鸣叫小周期结束
			beepClk=0;
			if(++beepCnt >= (beepCry+beepMut)){		// 鸣叫中周期结束
				beepCnt=0;
				if(++beepCct >= beepRep){			// 鸣叫大周期结束
					beepCct=0;
					if(beepRep < 100)	beepCry=0;	// 重复次数到达，结束鸣叫
				}
			}
		}else if(beepClk >= beepDty){				// 后半小周 不叫
			BEEP_OutOff();
		}else if(beepCnt < beepCry){				// （仅非停顿期间的）前半小周 鸣叫
			BEEP_OutOn();
		}
	}
}

/*****************************************************************************
* 功能:		LED初始化
*****************************************************************************/
void BEEP_Init(void)
{
	BEEP_GPIO_Config();
	BEEP_SetCycleDuty(200,100);
}












/***********************************************************************************************************************/
/*                                                     蜂鸣器控制函数                                                   */
/***********************************************************************************************************************/



/*****************************************************************************
* 功能:		短按按键时 蜂鸣器鸣叫方式
*****************************************************************************/
void BEEP_ShortPress(void)
{
	BEEP_Blink(1, 0, 0);			// 鸣叫一声
}


/*****************************************************************************
* 功能:		长按按键时 蜂鸣器鸣叫方式
*****************************************************************************/
void BEEP_LongPress(void)
{
	BEEP_Blink(2, 0, 0);			// 鸣叫两声
}


/*****************************************************************************
* 功能:		报警时 蜂鸣器鸣叫方式
*****************************************************************************/
void BEEP_Warn(void)
{
	BEEP_Blink(3, 5, 100);			// 鸣叫三声
}


/*****************************************************************************
* 功能:		报警解除时 蜂鸣器鸣叫方式
*****************************************************************************/
void BEEP_WarnOff(void)
{
	BEEP_Off();
}


/*****************************************************************************
* 功能:		蜂鸣器输出 开
*****************************************************************************/
void BEEP_OutOn(void)
{
	GPIO_SetPin(BEEP_GPIO,BEEP_PIN_MSK);
}

/*****************************************************************************
* 功能:		蜂鸣器输出 关
*****************************************************************************/
void BEEP_OutOff(void)
{
	GPIO_ResetPin(BEEP_GPIO,BEEP_PIN_MSK);
}




